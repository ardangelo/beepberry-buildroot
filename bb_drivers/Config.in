## bb_drivers/Config.in
```kconfig
source "$BR2_EXTERNAL_BB_DRIVERS_PATH/package/sharp_drm/Config.in"
source "$BR2_EXTERNAL_BB_DRIVERS_PATH/package/bbqX0kbd/Config.in"
```

## beepy_drivers/Config.in
```kconfig
source "$BR2_EXTERNAL_BEEPY_DRIVERS_PATH/package/sharp-drm/Config.in"
source "$BR2_EXTERNAL_BEEPY_DRIVERS_PATH/package/beepy-kbd/Config.in"
source "$BR2_EXTERNAL_BEEPY_DRIVERS_PATH/package/beepy-symbol-overlay/Config.in"
source "$BR2_EXTERNAL_BEEPY_DRIVERS_PATH/package/libgc/Config.in"
source "$BR2_EXTERNAL_BEEPY_DRIVERS_PATH/package/w3m/Config.in"
source "$BR2_EXTERNAL_BEEPY_DRIVERS_PATH/package/libxapian/Config.in"
source "$BR2_EXTERNAL_BEEPY_DRIVERS_PATH/package/gmime/Config.in"
source "$BR2_EXTERNAL_BEEPY_DRIVERS_PATH/package/notmuch/Config.in"
source "$BR2_EXTERNAL_BEEPY_DRIVERS_PATH/package/dante-preload/Config.in"
source "$BR2_EXTERNAL_BEEPY_DRIVERS_PATH/package/aerc/Config.in"
source "$BR2_EXTERNAL_BEEPY_DRIVERS_PATH/package/cmus/Config.in"
```

## beepy_drivers/Config.in.host
```kconfig
source "$BR2_EXTERNAL_BEEPY_DRIVERS_PATH/package/libgc/Config.in.host"
source "$BR2_EXTERNAL_BEEPY_DRIVERS_PATH/package/mktable/Config.in.host"
```

## beepy_drivers/package/aerc/Config.in
```kconfig
config BR2_PACKAGE_AERC
	bool "aerc"
	depends on BR2_LINUX_KERNEL
	select BR2_PACKAGE_OPENSSL
    select BR2_PACKAGE_HOST_GO_ARCH_SUPPORTS
	select BR2_PACKAGE_HOST_GO_CGO_LINKING_SUPPORTS
	select BR2_PACKAGE_NOTMUCH
	select BR2_PACKAGE_W3M
	select BR2_PACKAGE_DANTE_PRELOAD
	help
	  aerc email client
```

## beepy_drivers/package/beepy-symbol-overlay/Config.in
```kconfig
config BR2_PACKAGE_BEEPY_SYMBOL_OVERLAY
	bool "beepy-symbol-overlay"
	default y
	depends on BR2_LINUX_KERNEL
	select BR2_PACKAGE_SHARP_DRM
	help
	  Symbol menu overlay
```

## beepy_drivers/package/beepy-tmux-menus/Config.in
```kconfig
config BR2_PACKAGE_BEEPY_TMUX_MENUS
	bool "beepy-tmux-menus"
	default y
	depends on BR2_LINUX_KERNEL
	select BR2_PACKAGE_TMUX
	help
	  Beepy-customized tmux-menus
```

## beepy_drivers/package/cmus/Config.in
```kconfig
config BR2_PACKAGE_CMUS
	bool "cmus"
	depends on BR2_LINUX_KERNEL
	select BR2_PACKAGE_PIPEWIRE
	help
	  cmus music player
```

## beepy_drivers/package/gmime/Config.in
```kconfig
config BR2_PACKAGE_GMIME
	bool "gmime"
	depends on BR2_LINUX_KERNEL
	help
	  MIME type helper
```

## beepy_drivers/package/libgc/Config.in
```kconfig
config BR2_PACKAGE_LIBGC
	bool "libgc"
	default y
	depends on BR2_LINUX_KERNEL
	select BR2_PACKAGE_LIBATOMIC_OPS
	help
	  Garbage collector library
```

## beepy_drivers/package/libgc/Config.in.host
```kconfig
config BR2_PACKAGE_HOST_LIBGC
	bool "host libgc"
	default y
	depends on !BR2_LINUX_KERNEL
	select BR2_PACKAGE_HOST_LIBATOMIC_OPS
	help
	  Garbage collector library (host)
```

## beepy_drivers/package/libxapian/Config.in
```kconfig
config BR2_PACKAGE_LIBXAPIAN
	bool "libxapian"
	depends on BR2_LINUX_KERNEL
	select BR2_PACKAGE_UTIL_LINUX
	select BR2_PACKAGE_LIBUNWIND
	select BR2_PACKAGE_LIBZLIB
	help
	  Search engine library
```

## beepy_drivers/package/mktable/Config.in.host
```kconfig
config BR2_PACKAGE_HOST_MKTABLE
	bool "host mktable"
	select BR2_PACKAGE_HOST_LIBATOMIC_OPS
	help
	  W3M mktable tool
```

## beepy_drivers/package/notmuch/Config.in
```kconfig
config BR2_PACKAGE_NOTMUCH
	bool "notmuch"
	depends on BR2_LINUX_KERNEL
	select BR2_PACKAGE_LIBTALLOC
	select BR2_PACKAGE_LIBUNWIND
	select BR2_PACKAGE_LIBXAPIAN
	select BR2_PACKAGE_GMIME
	help
	  Mail indexer
```

## beepy_drivers/package/w3m/Config.in
```kconfig
config BR2_PACKAGE_W3M
	bool "w3m"
	depends on BR2_LINUX_KERNEL
	select BR2_PACKAGE_OPENSSL
	select BR2_PACKAGE_GPM
	select BR2_PACKAGE_NCURSES
	select BR2_PACKAGE_LIBGC
	select BR2_PACKAGE_HOST_LIBGC
	select BR2_PACKAGE_HOST_MKTABLE
	help
	  W3M browser
```

## br_defconfig
```kconfig
# Host packages
BR2_PACKAGE_HOST_DOSFSTOOLS=y
BR2_PACKAGE_HOST_GENIMAGE=y
BR2_PACKAGE_HOST_MTOOLS=y
BR2_TOOLCHAIN_BUILDROOT_CXX=y
BR2_CCACHE=y

# Machine setup
BR2_arm=y
BR2_cortex_a53=y
BR2_ARM_FPU_NEON_VFPV4=y

# Root filesystem
BR2_ROOTFS_DEVICE_CREATION_DYNAMIC_EUDEV=y
BR2_ROOTFS_USERS_TABLES="../users"
BR2_ROOTFS_OVERLAY="../root_overlay"
BR2_ROOTFS_POST_BUILD_SCRIPT="../post-build.sh"
BR2_ROOTFS_POST_IMAGE_SCRIPT="../post-image.sh"
BR2_TARGET_ROOTFS_F2FS=y
BR2_TARGET_ROOTFS_F2FS_SIZE="512M"

# Linux
BR2_LINUX_KERNEL=y
BR2_LINUX_KERNEL_CUSTOM_TARBALL=y
BR2_LINUX_KERNEL_CUSTOM_TARBALL_LOCATION="https://github.com/raspberrypi/linux/archive/refs/tags/1.20230405.tar.gz"
BR2_LINUX_KERNEL_USE_CUSTOM_CONFIG=y
BR2_LINUX_KERNEL_CUSTOM_CONFIG_FILE="../zero2w_defconfig"
BR2_LINUX_KERNEL_LZ4=y
BR2_LINUX_KERNEL_DTS_SUPPORT=y
BR2_LINUX_KERNEL_INTREE_DTS_NAME="bcm2710-rpi-zero-2-w"
BR2_LINUX_KERNEL_NEEDS_HOST_OPENSSL=y
BR2_GENERATE_LOCALE="en_US.UTF-8"

# Packages

## Patches we want to apply to existing packages go here
BR2_GLOBAL_PATCH_DIR="../patches"

## Firmware
BR2_PACKAGE_BRCMFMAC_SDIO_FIRMWARE_RPI=y
BR2_PACKAGE_BRCMFMAC_SDIO_FIRMWARE_RPI_WIFI=y
BR2_PACKAGE_BRCMFMAC_SDIO_FIRMWARE_RPI_BT=y
BR2_PACKAGE_RPI_FIRMWARE=y
BR2_PACKAGE_RPI_FIRMWARE_BOOTCODE_BIN=y
BR2_PACKAGE_RPI_FIRMWARE_VARIANT_PI_CD=y

## Drivers and utilities
BR2_PACKAGE_KBD=y
BR2_PACKAGE_CA_CERTIFICATES=y
BR2_PACKAGE_IWD=y
BR2_PACKAGE_NETWORK_MANAGER=y
BR2_PACKAGE_NETWORK_MANAGER_TUI=y
BR2_PACKAGE_NETWORK_MANAGER_CLI=y
BR2_PACKAGE_NTP=y
BR2_PACKAGE_NTP_NTPDATE=y
BR2_PACKAGE_OPENSSH=y
BR2_PACKAGE_F2FS_TOOLS=y
BR2_PACKAGE_NCURSES_TARGET_PROGS=y
BR2_PACKAGE_NCURSES_WCHAR=y
BR2_PACKAGE_WIRELESS_REGDB=y

## BlueZ
BR2_PACKAGE_JSON_C=y
BR2_PACKAGE_BLUEZ5_UTILS_HEADERS=y
BR2_PACKAGE_BLUEZ5_UTILS=y
BR2_PACKAGE_BLUEZ5_UTILS_CLIENT=y
BR2_PACKAGE_BLUEZ5_UTILS_MONITOR=y
BR2_PACKAGE_BLUEZ5_UTILS_TOOLS=y
BR2_PACKAGE_BLUEZ5_UTILS_PLUGINS_AUDIO=y
BR2_PACKAGE_BLUEZ5_UTILS_PLUGINS_HEALTH=y
BR2_PACKAGE_BLUEZ5_UTILS_PLUGINS_HID=y
BR2_PACKAGE_BLUEZ5_UTILS_PLUGINS_HOG=y
BR2_PACKAGE_BLUEZ5_UTILS_PLUGINS_MESH=y
BR2_PACKAGE_BLUEZ5_UTILS_PLUGINS_NETWORK=y
BR2_PACKAGE_BLUEZ5_UTILS_TOOLS_HID2HCI=y

## Pipewire
BR2_PACKAGE_PIPEWIRE=y
BR2_PACKAGE_PIPEWIRE_COMPRESS_OFFLOAD=y
BR2_PACKAGE_TINYCOMPRESS=y
BR2_PACKAGE_PIPEWIRE_MEDIA_SESSION=y

## SBC
BR2_PACKAGE_LIBSNDFILE=y
BR2_PACKAGE_SBC=y
BR2_PACKAGE_SBC_TOOLS=y

## Sound format support
BR2_PACKAGE_MPG123=y
BR2_PACKAGE_FDK_AAC=y
BR2_PACKAGE_LIBOPENAPTX=y

## Userspace
BR2_PACKAGE_BUSYBOX_SHOW_OTHERS=y
BR2_PACKAGE_BASH=y
BR2_PACKAGE_SUDO=y
BR2_PACKAGE_PARTED=y
BR2_PACKAGE_WGET=y
BR2_PACKAGE_LIBCURL_CURL=y
BR2_PACKAGE_RSYNC=y
BR2_PACKAGE_NANO=y
BR2_PACKAGE_TMUX=y
BR2_PACKAGE_PYTHON3=y
BR2_PACKAGE_PERL=y
BR2_PACKAGE_MOSH=y
BR2_PACKAGE_W3M=y
BR2_PACKAGE_NOTMUCH=y
BR2_PACKAGE_AERC=y
BR2_PACKAGE_CMUS=y
```
